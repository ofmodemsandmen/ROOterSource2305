// SPDX-License-Identifier: BSD-3-Clause
/*
 *  Copyright(c) 2017 Kristian Evensen <kristian.evensen@gmail.com>.
 *  Copyright(c) 2017 Piotr Dymacz <pepe2k@gmail.com>.
 *  All rights reserved.
 */

#include "mt7621_ws1688.dtsi"

/ {
	compatible = "huasifei,ws1688-32", "huasifei,ws1688-32", "mediatek,mt7621-soc";
	model = "Huasifei,ws1688-32";
};

&firmware {
	reg = <0x50000 0x1fb0000>;
};